## main/Kconfig.projbuild
```kconfig
menu "Application Role Configuration"

    choice APP_ROLE
        prompt "Device Operating Role"
        default APP_ROLE_NODE_TX
        help
            Select the operational role for this firmware build.
            - Node TX: Periodic telemetry transmitter
            - Gateway RX: Continuous packet receiver and logger
            - Ping-Pong: Two-board bidirectional link test

        config APP_ROLE_NODE_TX
            bool "Node TX (Transmitter)"

        config APP_ROLE_GATEWAY_RX
            bool "Gateway RX (Receiver)"

        config APP_ROLE_PING_PONG
            bool "Ping-Pong (Bidirectional P2P Test)"

    endchoice

    if APP_ROLE_PING_PONG

        choice APP_PING_PONG_MODE
            prompt "Ping-Pong Operating Mode"
            default APP_PING_PONG_MODE_INITIATOR
            help
                Select whether this device operates as the Ping-Pong Initiator (Node)
                or Responder (Gateway).
                - Initiator: Sends PING frames, waits for PONG, measures RTT.
                - Responder: Listens for PING frames, responds with matching PONG frames.

            config APP_PING_PONG_MODE_INITIATOR
                bool "Initiator (Node: Sends PING, measures RTT)"

            config APP_PING_PONG_MODE_RESPONDER
                bool "Responder (Gateway: Listens, responds with PONG)"

        endchoice

    endif

endmenu
```
